## AP/sdkconfig.defaults
```kconfig
# Configurações do Wi-Fi
CONFIG_ESP32_WIFI_SW_COEXIST_ENABLE=y
CONFIG_ESP32_WIFI_STATIC_RX_BUFFER_NUM=10
CONFIG_ESP32_WIFI_DYNAMIC_RX_BUFFER_NUM=32
CONFIG_ESP32_WIFI_DYNAMIC_TX_BUFFER_NUM=32
CONFIG_ESP32_WIFI_TX_BUFFER_TYPE=1
CONFIG_ESP32_WIFI_CACHE_TX_BUFFER_NUM=32
CONFIG_ESP32_WIFI_CSI_ENABLED=y

# Configurações de log
CONFIG_LOG_DEFAULT_LEVEL_INFO=y
CONFIG_LOG_DEFAULT_LEVEL=3

# Configurações de rede
CONFIG_LWIP_IPV6=y
CONFIG_LWIP_NETIF_LOOPBACK=y

# Configurações do sistema
CONFIG_ESP_SYSTEM_EVENT_QUEUE_SIZE=32
CONFIG_ESP_SYSTEM_EVENT_TASK_STACK_SIZE=2304
```

## AuthFlood/sdkconfig.defaults
```kconfig
# Configurações padrão para AuthFlood ESP32

# ESP32 Config
CONFIG_ESP32_DEFAULT_CPU_FREQ_240=y

# WiFi Config
CONFIG_ESP32_WIFI_STATIC_RX_BUFFER_NUM=10
CONFIG_ESP32_WIFI_DYNAMIC_RX_BUFFER_NUM=32
CONFIG_ESP32_WIFI_DYNAMIC_TX_BUFFER_NUM=32
CONFIG_ESP32_WIFI_TX_BUFFER_TYPE=1
CONFIG_ESP32_WIFI_CACHE_TX_BUFFER_NUM=32

# LWIP Config
CONFIG_LWIP_SO_REUSE=y
CONFIG_LWIP_SO_REUSE_RXTOALL=y

# Log Config
CONFIG_LOG_DEFAULT_LEVEL_INFO=y
CONFIG_LOG_MAXIMUM_EQUALS_DEFAULT=y

# Task Watchdog
CONFIG_ESP_TASK_WDT=y
CONFIG_ESP_TASK_WDT_PANIC=y
CONFIG_ESP_TASK_WDT_TIMEOUT_S=5

# FreeRTOS Config
CONFIG_FREERTOS_HZ=1000
CONFIG_ESP_SYSTEM_EVENT_QUEUE_SIZE=32

# Partition Table
CONFIG_PARTITION_TABLE_SINGLE_APP=y

# Random number generation
CONFIG_ESP32_RNG_BUILTIN=y
```

## CLIENTS/sdkconfig.defaults
```kconfig
# Configurações do Wi-Fi para Cliente
CONFIG_ESP32_WIFI_SW_COEXIST_ENABLE=y
CONFIG_ESP32_WIFI_STATIC_RX_BUFFER_NUM=10
CONFIG_ESP32_WIFI_DYNAMIC_RX_BUFFER_NUM=32
CONFIG_ESP32_WIFI_DYNAMIC_TX_BUFFER_NUM=32
CONFIG_ESP32_WIFI_TX_BUFFER_TYPE=1
CONFIG_ESP32_WIFI_CACHE_TX_BUFFER_NUM=32

# Configurações de log
CONFIG_LOG_DEFAULT_LEVEL_INFO=y
CONFIG_LOG_DEFAULT_LEVEL=3

# Configurações de rede
CONFIG_LWIP_IPV6=y
CONFIG_LWIP_NETIF_LOOPBACK=y

# Habilitar ping
CONFIG_LWIP_IPV4=y
CONFIG_LWIP_ICMP=y

# Configurações do sistema
CONFIG_ESP_SYSTEM_EVENT_QUEUE_SIZE=32
CONFIG_ESP_SYSTEM_EVENT_TASK_STACK_SIZE=2304

# Configurações específicas para cliente
CONFIG_ESP32_WIFI_CONNECT_TIMEOUT=30
CONFIG_ESP32_WIFI_SCAN_AUTH_MODE_THRESHOLD=1

# Desabilitar componentes desnecessários se ping não funcionar
# CONFIG_LWIP_ESP_PING_SOCK_ENABLE=n
```
